/dts-v1/;
/plugin/;

#include "monaco-nfc-pinctrl.dtsi"
/ {
	model = "Qualcomm Technologies, Inc. Monaco";
	compatible = "qcom,monaco";
	qcom,msm-id = <517 0x10000>, <486 0x10000>;
	qcom,board-id = <0 0>;
};
