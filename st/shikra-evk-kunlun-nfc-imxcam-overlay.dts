// SPDX-License-Identifier: BSD-3-Clause
/*
 * Copyright (c) Qualcomm Technologies, Inc. and/or its subsidiaries.
 */

/dts-v1/;
/plugin/;

#include "shikra-nfc-common-gpios.dtsi"

/ {
  model = "Qualcomm Technologies, Inc. Shikra EVK Kunlun NFC IMXCAM";
  compatible = "qcom,shikra-evk", "qcom,shikra-cqm", "qcom,shikra-cqs", "qcom,evk";
  qcom,msm-id = <756 0x10000>;
  qcom,board-id = <0x20033 0x01>, <0x20033 0x301>, <0x20033 0x401>, <0x20033 0x501>, <0x70033 0x01>, <0x70033 0x301>, <0x70033 0x401>, <0x70033 0x501>, <0x60033 0x01>, <0x60033 0x301>, <0x60033 0x401>, <0x60033 0x501>, <0x80033 0x0>, <0x80033 0x300>, <0x80033 0x400>, <0x80033 0x500>, <0x70033 0x0>, <0x70033 0x300>, <0x70033 0x400>, <0x70033 0x500>;
};
