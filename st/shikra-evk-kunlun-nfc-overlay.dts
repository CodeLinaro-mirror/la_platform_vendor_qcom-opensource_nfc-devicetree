// SPDX-License-Identifier: BSD-3-Clause
/*
 * Copyright (c) Qualcomm Technologies, Inc. and/or its subsidiaries.
 */

/dts-v1/;
/plugin/;

#include "shikra-nfc-common-gpios.dtsi"

/ {
  model = "Qualcomm Technologies, Inc. Shikra Kunlun NFC";
  compatible = "qcom,shikra-evk", "qcom,shikra-cqm", "qcom,shikra-cqs", "qcom,evk", "qcom,shikra-eitp", "qcom,shikrap-eitp", "qcom,shikrap", "qcom,eitp";
  qcom,msm-id = <756 0x10000>, <758 0x10000>;
  qcom,board-id = <0x20033 0x0>, <0x20033 0x300>, <0x20033 0x400>, <0x20033 0x500>, <0x10021 0x0>, <0x10021 0x300>, <0x10021 0x400>, <0x10021 0x500>, <0x70033 0x01>, <0x70033 0x301>, <0x70033 0x401>, <0x70033 0x501>, <0x60033 0x01>, <0x60033 0x301>, <0x60033 0x401>, <0x60033 0x501>, <0x80033 0x0>, <0x80033 0x300>, <0x80033 0x400>, <0x80033 0x500>, <0x70033 0x0>, <0x70033 0x300>, <0x70033 0x400>, <0x70033 0x500>, <0x50033 0x0>, <0x50033 0x300>, <0x50033 0x400>, <0x50033 0x500>, <0x10033 0x2>, <0x10033 0x302>, <0x10033 0x402>, <0x10033 0x502>;
};
