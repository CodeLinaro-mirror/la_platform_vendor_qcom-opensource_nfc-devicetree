// SPDX-License-Identifier: BSD-3-Clause

/*
 * Copyright (c) 2024 Qualcomm Innovation Center, Inc. All rights reserved.
 */

/dts-v1/;
/plugin/;

#include "canoe-nfc-common-gpios.dtsi"
/ {
        model = "Qualcomm Technologies, Inc. Canoe SoC";
        compatible = "qcom,canoe";
        qcom,msm-id = <660 0x10000>, <660 0x20000>, <661 0x10000>, <661 0x20000>,
                      <0x1000294 0x10000>, <0x1000294 0x20000>,
                      <0x1000295 0x10000>, <0x1000295 0x20000>;
        qcom,board-id = <0x10021 0>, <1 0>, <0x1000001 0>, <0x2000001 0>,
                        <8 0>, <0x1000008 0>, <0x4000008 0>, <0x6000008 0>,
                        <11 0>, <0x100000B 0>, <0x200000B 0>,
                        <0x15 0>, <0x1000015 0>, <0x2000015 0>;
};
